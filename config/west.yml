## config/west.yml
```yaml
manifest:
  remotes:
    - name: zmkfirmware
      url-base: https://github.com/zmkfirmware
    - name: badjeff
      url-base: https://github.com/badjeff
  projects:
    - name: zmk
      remote: zmkfirmware
      revision: 6e7e0de2b621073392816b284ab4931bee709ee8
      import: app/west.yml
    - name: zmk-pmw3610-driver
      remote: badjeff
      revision: main
      
  self:
    path: config
```
